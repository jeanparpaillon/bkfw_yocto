## build/conf/bblayers.conf
```bitbake
# POKY_BBLAYERS_CONF_VERSION is increased each time build/conf/bblayers.conf
# changes incompatibly
POKY_BBLAYERS_CONF_VERSION = "2"

BBPATH = "${TOPDIR}"
BBFILES ?= ""

BBLAYERS ?= " \
  /home/jean/BA_Projets/bktel/git/bkfw_yocto/poky/meta \
  /home/jean/BA_Projets/bktel/git/bkfw_yocto/poky/meta-poky \
  /home/jean/BA_Projets/bktel/git/bkfw_yocto/poky/meta-yocto-bsp \
  /home/jean/BA_Projets/bktel/git/bkfw_yocto/meta-openembedded/meta-oe \
  /home/jean/BA_Projets/bktel/git/bkfw_yocto/meta-python2 \
  /home/jean/BA_Projets/bktel/git/bkfw_yocto/meta-raspberrypi \
  /home/jean/BA_Projets/bktel/git/bkfw_yocto/meta-erlang \
  /home/jean/BA_Projets/bktel/git/bkfw_yocto/meta-bkfw \
  "
```

## build/conf/local.conf
```bitbake
MACHINE ??= "raspberrypi3"

DL_DIR ?= "${HOME}/BA_Projets/yocto/downloads"
SSTATE_DIR ?= "${HOME}/BA_Projets/yocto/sstate-cache"

#TMPDIR = "${TOPDIR}/tmp"

DISTRO ?= "poky"

#DISTRO_FEATURES_append = " systemd"
#VIRTUAL-RUNTIME_init_manager = "systemd"
#DISTRO_FEATURES_BACKFILL_CONSIDERED = "sysvinit"
#VIRTUAL-RUNTIME_initscripts = ""

PACKAGE_CLASSES ?= "package_ipk"

IMAGE_FSTYPES = "rpi-sdimg"

#
# Extra image configuration defaults
#
# The EXTRA_IMAGE_FEATURES variable allows extra packages to be added to the generated
# images. Some of these options are added to certain image types automatically. The
# variable can contain the following options:
#  "dbg-pkgs"       - add -dbg packages for all installed packages
#                     (adds symbol information for debugging/profiling)
#  "dev-pkgs"       - add -dev packages for all installed packages
#                     (useful if you want to develop against libs in the image)
#  "ptest-pkgs"     - add -ptest packages for all ptest-enabled packages
#                     (useful if you want to run the package test suites)
#  "tools-sdk"      - add development tools (gcc, make, pkgconfig etc.)
#  "tools-debug"    - add debugging tools (gdb, strace)
#  "eclipse-debug"  - add Eclipse remote debugging support
#  "tools-profile"  - add profiling tools (oprofile, lttng, valgrind)
#  "tools-testapps" - add useful testing tools (ts_print, aplay, arecord etc.)
#  "debug-tweaks"   - make an image suitable for development
#                     e.g. ssh root access has a blank password
# There are other application targets that can be used here too, see
# meta/classes/image.bbclass and meta/classes/core-image.bbclass for more details.
# We default to enabling the debugging tweaks.
EXTRA_IMAGE_FEATURES ?= "debug-tweaks package-management"
#EXTRA_IMAGE_FEATURES += "read-only-rootfs"

#
# Additional image features
#
# The following is a list of additional classes to use when building images which
# enable extra features. Some available options which can be included in this variable
# are:
#   - 'buildstats' collect build statistics
#   - 'image-mklibs' to reduce shared library files size for an image
#   - 'image-prelink' in order to prelink the filesystem image
#   - 'image-swab' to perform host system intrusion detection
# NOTE: if listing mklibs & prelink both, then make sure mklibs is before prelink
# NOTE: mklibs also needs to be explicitly enabled for a given image, see local.conf.extended
# image-prelink disabled for now due to issues with IFUNC symbol relocation
USER_CLASSES ?= "buildstats image-mklibs"

PATCHRESOLVE = "noop"

BB_DISKMON_DIRS = "\
    STOPTASKS,${TMPDIR},1G,100K \
    STOPTASKS,${DL_DIR},1G,100K \
    STOPTASKS,${SSTATE_DIR},1G,100K \
    STOPTASKS,/tmp,100M,100K \
    ABORT,${TMPDIR},100M,1K \
    ABORT,${DL_DIR},100M,1K \
    ABORT,${SSTATE_DIR},100M,1K \
    ABORT,/tmp,10M,1K"

#
# Qemu configuration
#
# By default qemu will build with a builtin VNC server where graphical output can be
# seen. The two lines below enable the SDL backend too. By default libsdl-native will
# be built, if you want to use your host's libSDL instead of the minimal libsdl built
# by libsdl-native then uncomment the ASSUME_PROVIDED line below.
PACKAGECONFIG_append_pn-qemu-native = " sdl"
PACKAGECONFIG_append_pn-nativesdk-qemu = " sdl"
#ASSUME_PROVIDED += "libsdl-native"

### raspberrypi options
ENABLE_SPI_BUS = "1"
ENABLE_I2C = "1"
DISABLE_OVERSCAN = "1"

# CONF_VERSION is increased each time build/conf/ changes incompatibly and is used to
# track the version of this file when it was generated. This can safely be ignored if
# this doesn't mean anything to you.
CONF_VERSION = "1"

IMAGE_INSTALL_append = " opkg"

ENABLE_UART="1"
CMDLINE_SERIAL=""

ENABLE_KGDB="0"

SERIAL_CONSOLE=""
RPI_EXTRA_CONFIG = "dtoverlay=disable-bt"

LICENSE_FLAGS_WHITELIST += "commercial"

I_SWEAR_TO_MIGRATE_TO_PYTHON3="yes"
```

## meta-bkfw/conf/layer.conf
```bitbake
# We have a conf and classes directory, append to BBPATH
BBPATH .= ":${LAYERDIR}"

# We have a recipes directory, add to BBFILES
BBFILES += "${LAYERDIR}/recipes*/*/*.bb ${LAYERDIR}/recipes*/*/*.bbappend ${LAYERDIR}/images/*.bb"

BBFILE_COLLECTIONS += "meta-bkfw"
BBFILE_PATTERN_meta-bkfw := "^${LAYERDIR}/"
BBFILE_PRIORITY_meta-bkfw = "8"
```
